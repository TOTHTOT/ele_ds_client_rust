## sdkconfig.defaults
```kconfig
# Rust often needs a bit of an extra main task stack size compared to C (the default is 3K)
CONFIG_ESP_MAIN_TASK_STACK_SIZE=16000

# Use this to set FreeRTOS kernel tick frequency to 1000 Hz (100 Hz by default).
# This allows to use 1 ms granularity for thread sleeps (10 ms by default).
#CONFIG_FREERTOS_HZ=1000

# Workaround for https://github.com/espressif/esp-idf/issues/7631
#CONFIG_MBEDTLS_CERTIFICATE_BUNDLE=n
#CONFIG_MBEDTLS_CERTIFICATE_BUNDLE_DEFAULT_FULL=n

CONFIG_ESP_TLS_ALLOW_HTTPD_INSECURE_OPTIONS=y
CONFIG_ESP_TLS_SKIP_SERVER_CERT_VERIFY=y
CONFIG_MBEDTLS_CERTIFICATE_BUNDLE=n
CONFIG_ESP_TLS_INSECURE=y

# 开启电源管理
CONFIG_PM_ENABLE=y
# 开启轻度睡眠时自动补偿系统时间的 Tick
CONFIG_PM_SLP_DEFAULT_PARAMS_OPT=y
CONFIG_PM_UPDATE_TERTIARY_SYS_TM=y
CONFIG_ESP_SYSTEM_TIME_SYSCALL=y
CONFIG_PM_SUPPORT_LIGHT_SLEEP=y

# 开启 SPIRAM 支持
CONFIG_SPIRAM=y
CONFIG_SPIRAM_TYPE_AUTO=y
CONFIG_SPIRAM_MODE_OCT=y
CONFIG_ESP32S3_DATA_CACHE_64KB=y
CONFIG_SPIRAM_USE_MALLOC=y
CONFIG_SPIRAM_MALLOC_RESERVE_INTERNAL=32768
CONFIG_SPIRAM_SPEED_80M=y
CONFIG_SPIRAM_MEMTEST=n
```
